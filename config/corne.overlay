&spi2 {
    compatible = "nordic,nrf-spim";
    status = "okay";
    sck-pin = <2>;
    mosi-pin = <3>;
    miso-pin = <4>;
    cs-gpios = <&gpio0 30 0>;
};

&nice_view {
    compatible = "zmk,display";
    nice_view-spi = <&spi2>;
};
